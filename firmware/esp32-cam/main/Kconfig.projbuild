## firmware/esp32-cam/main/Kconfig.projbuild
```kconfig
menu "OPEN-FC Vision Precision Landing (ESP32-CAM)"

config OPENFC_CAM_UART_PORT
    int "ESP32-CAM UART peripheral connected to J_CAM (FC SERIAL2)"
    range 0 2
    default 1

config OPENFC_CAM_UART_BAUD
    int "UART baudrate matching OPENFCF405 SERIAL2_BAUD (candidate: 115200)"
    range 57600 921600
    default 115200

config OPENFC_CAM_UART_TX_GPIO
    int "ESP32-CAM UART TX GPIO -> J_CAM Pin 4 (FC PA3 RX) [candidate]"
    range 0 33
    default 14

config OPENFC_CAM_UART_RX_GPIO
    int "ESP32-CAM UART RX GPIO <- J_CAM Pin 3 (FC PA2 TX) [candidate]"
    range 0 39
    default 15

config OPENFC_CAM_MAV_SYS_ID
    int "MAVLink2 system ID (match FC sysid=1)"
    range 1 255
    default 1

config OPENFC_CAM_MAV_COMP_ID
    int "MAVLink2 component ID (191 = MAV_COMP_ID_ONBOARD_COMPUTER)"
    range 1 255
    default 191

config OPENFC_CAM_MAX_FRAME_AGE_MS
    int "Maximum allowed frame age before dropping LANDING_TARGET (ms)"
    range 20 500
    default 150

config OPENFC_CAM_FX_MILLIPX
    int "Calibrated fx * 1000 (0 = UNCALIBRATED -> blocks LANDING_TARGET TX)"
    range 0 10000000
    default 0

config OPENFC_CAM_FY_MILLIPX
    int "Calibrated fy * 1000 (0 = UNCALIBRATED -> blocks LANDING_TARGET TX)"
    range 0 10000000
    default 0

config OPENFC_CAM_CX_MILLIPX
    int "Calibrated cx * 1000 (default 160000 for QVGA 320x240)"
    range 0 10000000
    default 160000

config OPENFC_CAM_CY_MILLIPX
    int "Calibrated cy * 1000 (default 120000 for QVGA 320x240)"
    range 0 10000000
    default 120000

config OPENFC_CAM_YAW_OFFSET_MDEG
    int "Camera yaw offset relative to FRD body frame in millidegrees"
    range -360000 360000
    default 0

endmenu
```

## firmware/esp32-wifi/main/Kconfig.projbuild
```kconfig
menu "OPEN-FC Wi-Fi MAVLink2 Bridge"

config OPENFC_WIFI_MODE_AP
    bool "Run ESP32 as SoftAP (uncheck for STA client)"
    default y

config OPENFC_WIFI_SSID
    string "Wi-Fi SSID (placeholder in repo; set locally in untracked sdkconfig)"
    default "OPENFC_AP_PLACEHOLDER"

config OPENFC_WIFI_PASS
    string "Wi-Fi Password (min 8 chars for WPA2; set locally in untracked sdkconfig)"
    default "CHANGE_ME_LOCAL_ONLY"

config OPENFC_GCS_IP
    string "Default GCS UDP IPv4 destination (learned dynamically on first GCS packet)"
    default "192.168.4.2"

config OPENFC_GCS_UDP_PORT
    int "GCS UDP destination port"
    range 1024 65535
    default 14550

config OPENFC_LOCAL_UDP_PORT
    int "Local UDP bind port"
    range 1024 65535
    default 14550

config OPENFC_UART_PORT
    int "ESP32 UART peripheral number connected to J_WIFI (candidate: UART2)"
    range 1 2
    default 2

config OPENFC_UART_BAUD
    int "UART baudrate matching OPENFCF405 SERIAL1_BAUD (candidate: 921600)"
    range 57600 2000000
    default 921600

config OPENFC_UART_TX_GPIO
    int "ESP32 UART TX GPIO -> J_WIFI Pin 4 (FC PA10 RX) [candidate]"
    range 0 33
    default 17

config OPENFC_UART_RX_GPIO
    int "ESP32 UART RX GPIO <- J_WIFI Pin 3 (FC PA9 TX) [candidate]"
    range 0 39
    default 16

endmenu
```
